/dts-v1/;
/plugin/;

#include <dt-bindings/clock/qcom,camcc-waipio.h>
#include <dt-bindings/clock/qcom,gcc-waipio.h>
#include <dt-bindings/interconnect/qcom,waipio.h>
#include <dt-bindings/interrupt-controller/arm-gic.h>
#include <dt-bindings/regulator/qcom,rpmh-regulator-levels.h>


#include "zizhan-sm8475.dtsi"
#include "zizhan-pm8008.dtsi"
#include "audio/zizhan-audio.dtsi"
#include "camera/zizhan-sm8475-camera-sensor.dtsi"
#include "display/display/zizhan-sde-display-cape-mtp.dtsi"
/ {
	model = "Zizhan based on Qualcomm Technologies, Inc SM8475";
	compatible = "qcom,cape-mtp", "qcom,cape", "qcom,mtp";
	qcom,msm-id = <530 0x10000>, <531 0x10000>, <540 0x10000>;
	qcom,board-id = <0x10008 0>;
	xiaomi,miboard-id = <0x5 0>;
};

