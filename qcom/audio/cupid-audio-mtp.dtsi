#include "xiaomi-sm8450-common.dtsi"

&soc {
	sbu_uart_en: msm_cdc_pinctrl@74 {
		compatible = "qcom,msm-cdc-pinctrl";
		pinctrl-names = "aud_active", "aud_sleep";
		pinctrl-0 = <&sbu_uart_en_active_cup>;
		pinctrl-1 = <&sbu_uart_en_idle_cup>;
		#gpio-cells = <0>;
	};
};

&swr_haptics {
	status = "disabled";
};
