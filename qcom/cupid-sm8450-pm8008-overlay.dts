/dts-v1/;
/plugin/;

#include <dt-bindings/clock/qcom,camcc-waipio.h>
#include <dt-bindings/clock/qcom,gcc-waipio.h>
#include <dt-bindings/interconnect/qcom,waipio.h>
#include <dt-bindings/interrupt-controller/arm-gic.h>
#include <dt-bindings/regulator/qcom,rpmh-regulator-levels.h>

#include "cupid-sm8450.dtsi"
#include "cupid-pm8008.dtsi"

#include "audio/cupid-audio-mtp.dtsi"
#include "camera/cupid-sm8450-camera-sensor.dtsi"
#include "display/display/cupid-sde-display-mtp.dtsi"

/ {
	model = "Cupid based on Qualcomm Technologies, Inc SM8450";
	compatible = "qcom,waipio-mtp", "qcom,waipio", "qcom,mtp";
	qcom,msm-id = <457 0x10000>, <457 0x20000>;
	qcom,board-id = <0x10008 0>;
	xiaomi,miboard-id = <0x2 0>;
};
